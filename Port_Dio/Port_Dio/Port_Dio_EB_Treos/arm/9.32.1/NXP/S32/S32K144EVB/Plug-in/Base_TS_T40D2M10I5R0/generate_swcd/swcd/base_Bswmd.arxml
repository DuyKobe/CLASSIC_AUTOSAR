AUTOSAR XML (schema 4-0-3)
package /AUTOSAR_Base/BswModuleDescriptions
  bsw module description Base: module-id=0
package /Base_TS_T40D2M10I5R0/Implementations
  bsw implementation BswImplementation_0: programming-language=C, sw-version=4.2.2, vendor-id=43, ar-release-version=4.2.2, behavior=InternalBehavior_0, vendor-specific-module-def=Base
    code-descriptors:
      code Files
        artifact-descriptors:
          short-label=config::Base.xdm, category=SWCFG
          short-label=doc::AUTOSAR_MCAL_BASE_IM.pdf, category=SWDOC
          short-label=doc::AUTOSAR_MCAL_BASE_UM.pdf, category=SWDOC
          short-label=include::Adc_MemMap.h, category=SWHDR
          short-label=include::Can_GeneralTypes.h, category=SWHDR
          short-label=include::Can_MemMap.h, category=SWHDR
          short-label=include::Compiler.h, category=SWHDR
          short-label=include::CompilerDefinition.h, category=SWHDR
          short-label=include::Compiler_Cfg.h, category=SWHDR
          short-label=include::ComStack_Cfg.h, category=SWHDR
          short-label=include::ComStack_Types.h, category=SWHDR
          short-label=include::Crcu_MemMap.h, category=SWHDR
          short-label=include::Crypto_MemMap.h, category=SWHDR
          short-label=include::Csec_MemMap.h, category=SWHDR
          short-label=include::Dio_MemMap.h, category=SWHDR
          short-label=include::Eep_MemMap.h, category=SWHDR
          short-label=include::EthSwitch_43_SJA1105P_MemMap.h, category=SWHDR
          short-label=include::EthSwt_43_SJA1110_MemMap.h, category=SWHDR
          short-label=include::EthTrcv_43_TJA110X_MemMap.h, category=SWHDR
          short-label=include::Eth_GeneralTypes.h, category=SWHDR
          short-label=include::Eth_MemMap.h, category=SWHDR
          short-label=include::Fee_MemMap.h, category=SWHDR
          short-label=include::Fls_MemMap.h, category=SWHDR
          short-label=include::Fr_GeneralTypes.h, category=SWHDR
          short-label=include::Fr_MemMap.h, category=SWHDR
          short-label=include::Gpt_MemMap.h, category=SWHDR
          short-label=include::I2c_MemMap.h, category=SWHDR
          short-label=include::Icu_MemMap.h, category=SWHDR
          short-label=include::Iseled_MemMap.h, category=SWHDR
          short-label=include::Lin_GeneralTypes.h, category=SWHDR
          short-label=include::Lin_MemMap.h, category=SWHDR
          short-label=include::Mcal.h, category=SWHDR
          short-label=include::Mcem_MemMap.h, category=SWHDR
          short-label=include::Mcl_MemMap.h, category=SWHDR
          short-label=include::Mcu_MemMap.h, category=SWHDR
          short-label=include::Ocu_MemMap.h, category=SWHDR
          short-label=include::Platform_Types.h, category=SWHDR
          short-label=include::Port_MemMap.h, category=SWHDR
          short-label=include::Pwm_MemMap.h, category=SWHDR
          short-label=include::RegLockMacros.h, category=SWHDR
          short-label=include::Reg_eSys.h, category=SWHDR
          short-label=include::SilRegMacros.h, category=SWHDR
          short-label=include::Spi_MemMap.h, category=SWHDR
          short-label=include::StdRegMacros.h, category=SWHDR
          short-label=include::Std_Types.h, category=SWHDR
          short-label=include::Wdg_MemMap.h, category=SWHDR
    compiler IAR_Compiler: name=IAR Compiler, options=--cpu=Cortex-M4 --cpu=Cortex-M0+ --cpu_mode=thumb --endian=little -Ohz -c --no_clustering --no_mem_idioms --no_explicit_zero_opt --debug --diag_suppress=Pa050 -DAUTOSAR_OS_NOT_USED -DIAR --require_prototypes --no_wrap_diagnostics --no_system_include -e, vendor=IAR Systems, version=IAR: V8.11.2
    compiler GHS_Compiler:
      name=Green Hills
      options=-cpu=cortexm4 -cpu=cortexm0plus -ansi -Osize -dual_debug -G --no_exceptions -Wundef -Wimplicit-int -Wshadow -Wtrigraphs -Wall --prototype_errors --incorrect_pragma_warnings -noslashcomment -preprocess_assembly_files -nostartfile --short_enum -c --no_commons -keeptempfiles -list -DAUTOSAR_OS_NOT_USED -DDISABLE_MCAL_INTERMODULE_ASR_CHECK -DGHS
      vendor=Green Hills
      version=Green Hills Multi 7.1.4 / Compiler 2017.1.4
    generated-artifacts:
      dependency on artifact modules_h: artifact-descriptor={short-label=generate_PC::include::modules.h, category=SWHDR}, usages=COMPILE
      dependency on artifact Soc_Ips_h: artifact-descriptor={short-label=generate_PC::include::Soc_Ips.h, category=SWHDR}, usages=COMPILE
    linker IAR_Linker: name=IAR Compiler, options=--cpu=Cortex-M4 --cpu=Cortex-M0+ --map filename --no_library_search --entry _start --enable_stack_usage --skip_dynamic_initialization --no_wrap_diagnostics --config, vendor=IAR Systems, version=IAR: V8.11.2
    linker GHS_Linker: name=Green Hills, options=-Mn -delete -v -ignore_debug_references -map -keepmap -lstartup -lsys -larch -lansi -L(/lib/thumb2) -lutf8_s32, vendor=Green Hills, version=Green Hills Multi 7.1.4 / Compiler 2017.1.4
    resource consumption ResourceConsumption
